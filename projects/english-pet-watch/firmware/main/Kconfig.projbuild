## projects/english-pet-watch/firmware/main/Kconfig.projbuild
```kconfig
menu "English Pet Watch"

config EPW_WIFI_SSID
    string "Wi-Fi SSID"
    default ""
    help
      2.4GHz Wi-Fi 名称。ESP32-S3 不支持 5GHz。
      手机热点请打开 2.4GHz 兼容模式。

config EPW_WIFI_PASSWORD
    string "Wi-Fi password"
    default ""
    help
      Wi-Fi 密码。不要提交到 git；本仓库只保存固件源码与模板。

config EPW_DEVICE_MODEL
    string "Device model (OTA file prefix)"
    default "epw-watch-175"
    help
      服务端 data/bin 里的固件文件名格式为 {model}_{version}.bin。
      本值必须与文件名前缀完全一致，否则服务端不会下发固件。

config EPW_DEVICE_NAME
    string "Device display name"
    default "English Pet Watch"

config EPW_OTA_URL
    string "OTA check URL"
    default "http://192.168.1.100:8003/xiaozhi/ota/"
    help
      xiaozhi-server 的 OTA 端点。
      局域网：http://<服务器局域网IP>:8003/xiaozhi/ota/
      公网：https://<域名>/xiaozhi/ota/

config EPW_OTA_CHECK_INTERVAL_S
    int "OTA check interval (seconds)"
    range 60 86400
    default 300
    help
      开机检查一次，之后按这个间隔轮询。

endmenu
```

## projects/english-pet-watch/firmware/sdkconfig.defaults
```kconfig
# 英语宠物怀表 · 自研固件默认配置
# 目标板：Waveshare ESP32-S3-Touch-AMOLED-1.75C（ESP32-S3 rev v0.2，32MB Flash / 8MB PSRAM，实测）

CONFIG_IDF_TARGET="esp32s3"

# Flash：32MB（实板 GD c8/4019），QIO 80MHz
CONFIG_ESPTOOLPY_FLASHSIZE_32MB=y
CONFIG_ESPTOOLPY_FLASHMODE_QIO=y
CONFIG_ESPTOOLPY_FLASHFREQ_80M=y

# PSRAM：8MB Octal PSRAM（V0.2 音频缓冲与屏幕帧缓冲要用）
CONFIG_SPIRAM=y
CONFIG_SPIRAM_MODE_OCT=y
CONFIG_SPIRAM_SPEED_80M=y
CONFIG_SPIRAM_USE_MALLOC=y

# 自定义分区表：双 OTA 槽
CONFIG_PARTITION_TABLE_CUSTOM=y
CONFIG_PARTITION_TABLE_CUSTOM_FILENAME="partitions.csv"

# OTA 允许 http（局域网联调）；公网部署应改用 https
CONFIG_ESP_HTTPS_OTA_ALLOW_HTTP=y

# OTA 任务会做 JSON 解析与日志，主任务栈给足
CONFIG_ESP_MAIN_TASK_STACK_SIZE=8192
```

## projects/english-pet-watch/firmware/ui_demo/main/Kconfig.projbuild
```kconfig
menu "English Pet Watch UI Demo"

config EPW_WIFI_SSID
    string "Wi-Fi hotspot SSID"
    default ""
    help
        SSID of the 2.4GHz hotspot. Put the real value in sdkconfig
        (or sdkconfig.local) and do not commit it.

config EPW_WIFI_PASSWORD
    string "Wi-Fi hotspot password"
    default ""
    help
        WPA2 password. Put the real value in sdkconfig (or sdkconfig.local)
        and do not commit it.

config EPW_WIFI_MAX_RETRY
    int "Initial reconnect attempts"
    default 20
    help
        After this many quick retries the firmware waits 15 seconds
        and tries again, forever.

config EPW_PET_BRIDGE_URL
    string "Doubao pet bridge URL"
    default ""
    help
        Optional HTTP(S) GET endpoint returning
        {"emotion":"happy","text":"Hello"}.
        The real Doubao / xiaozhi-server call stays on the server; the
        device only polls this lightweight JSON. Leave empty to use the
        built-in local scenario engine only.

config EPW_PET_BRIDGE_INTERVAL_MS
    int "Pet bridge poll interval (ms)"
    default 8000
    range 2000 60000
    help
        Poll period for the pet bridge endpoint.

config EPW_VOICE_WS_URL
    string "Doubao voice WebSocket URL"
    default ""
    help
        xiaozhi-server v1 endpoint used for the full voice loop
        (VAD / ASR / Doubao LLM / TTS), for example:
        ws://<服务器IP>:8000/xiaozhi/v1/
        Leave empty to disable the voice channel. Put real values in
        sdkconfig.local (not committed).

config EPW_VOICE_TOKEN
    string "Voice server access token"
    default ""
    help
        Optional Bearer token for xiaozhi-server. Keep the real value in
        sdkconfig.local (not committed).

config EPW_NURSERY_BASE
    string "Nursery catalog base URL"
    default ""
    help
        3S nursery catalog root, for example
        http://<服务器IP>:8083/family/modules/nursery/
        Leave empty to disable HTTP nursery catalog downloads.

config EPW_BOOT_SHOTS
    bool "Boot-time screenshot capture"
    default n
    help
        Enable only for demo/QA builds: after boot the firmware cycles
        through all pages and dumps LVGL snapshots as base64 over serial.
        Keep disabled for normal firmware.

endmenu
```

## projects/english-pet-watch/firmware/ui_demo/sdkconfig.defaults
```kconfig
# 英语宠物怀表 · UI Demo 默认配置
# 目标板：Waveshare ESP32-S3-Touch-AMOLED-1.75C

CONFIG_ESPTOOLPY_FLASHMODE_QIO=y
CONFIG_ESPTOOLPY_FLASHSIZE_32MB=y
CONFIG_PARTITION_TABLE_CUSTOM=y

CONFIG_COMPILER_OPTIMIZATION_PERF=y
CONFIG_ESP_DEFAULT_CPU_FREQ_MHZ_240=y

# 32MB Flash / 8MB Octal PSRAM（实测）
CONFIG_SPIRAM=y
CONFIG_SPIRAM_MODE_OCT=y
CONFIG_SPIRAM_SPEED_80M=y
# 只把指令放入 PSRAM；完整中文字库与表情留在 Flash，避免挤占 UI/音频堆。
CONFIG_SPIRAM_FETCH_INSTRUCTIONS=y
# CONFIG_SPIRAM_RODATA is not set
# CONFIG_SPIRAM_XIP_FROM_PSRAM is not set
CONFIG_ESP32S3_INSTRUCTION_CACHE_32KB=y
CONFIG_ESP32S3_DATA_CACHE_64KB=y
CONFIG_ESP32S3_DATA_CACHE_LINE_64B=y

# LVGL 9
CONFIG_FREERTOS_HZ=1000
CONFIG_LV_USE_CLIB_MALLOC=y
CONFIG_LV_USE_CLIB_STRING=y
CONFIG_LV_USE_CLIB_SPRINTF=y
CONFIG_LV_DEF_REFR_PERIOD=15
CONFIG_LV_OS_FREERTOS=y
CONFIG_LV_OBJ_STYLE_CACHE=y
CONFIG_LV_DRAW_SW_DRAW_UNIT_CNT=1
# 注意：LV_ATTRIBUTE_FAST_MEM_USE_IRAM 与 ESP-IDF 6.0 的 section 属性冲突
# （-Werror=attributes），保持关闭。

# 表盘用到的字号（Montserrat，ASCII）
CONFIG_LV_FONT_MONTSERRAT_12=y
CONFIG_LV_FONT_MONTSERRAT_14=y
CONFIG_LV_FONT_MONTSERRAT_16=y
CONFIG_LV_FONT_MONTSERRAT_18=y
CONFIG_LV_FONT_MONTSERRAT_20=y
CONFIG_LV_FONT_MONTSERRAT_24=y
CONFIG_LV_FONT_MONTSERRAT_28=y
CONFIG_LV_FONT_MONTSERRAT_40=y
CONFIG_LV_FONT_MONTSERRAT_48=y
CONFIG_LV_USE_FONT_COMPRESSED=y
# 中文字体含 GB2312 全集（6879 字形），bitmap 偏移超过 20bit，需要 LARGE 模式
CONFIG_LV_FONT_FMT_TXT_LARGE=y
CONFIG_LV_TXT_BREAK_CHARS=" ,.;:-_"

# 真机截图（Shot 调试功能，运行时由 CONFIG_EPW_BOOT_SHOTS 控制）
CONFIG_LV_USE_SNAPSHOT=y

CONFIG_ESP_MAIN_TASK_STACK_SIZE=8192
CONFIG_IDF_EXPERIMENTAL_FEATURES=y

# 串口截图/日志吞吐：UART0 主控制台提速（USB-JTAG 从控制台同步镜像）
CONFIG_ESP_CONSOLE_UART_BAUDRATE=921600

# 网络 JSON 仅需少量嵌套，限制解析器递归深度以保护任务栈。
CONFIG_CJSON_NESTING_LIMIT=16

# 录音上传不与接收回调争用同一个锁。
CONFIG_ESP_WS_CLIENT_SEPARATE_TX_LOCK=y

# 热点网络校时：国内主备 NTP，HTTP Date 仅用于首次校时兜底。
CONFIG_LWIP_SNTP_MAX_SERVERS=3

# mbedTLS 缓冲区放 PSRAM：内部 RAM 要留给 LVGL 绘制与音频 DMA。
# 默认 INTERNAL 模式下 TLS 输入 16KB + 输出 4KB 只能挤内部 RAM，
# 萧山天气 HTTPS 建链时 mbedtls_ssl_setup 会因内存不足返回 -0x008D。
CONFIG_MBEDTLS_EXTERNAL_MEM_ALLOC=y
```
